## samples/suit/suit_ab_images/sample.yaml
```yaml
#
# Copyright (c) 2023 Nordic Semiconductor ASA
#
# SPDX-License-Identifier: LicenseRef-Nordic-5-Clause
#

sample:
  name: SUIT update through SMP sample
  description: Sample application that updates firmware using SUIT and SMP protocol
common:
  platform_allow: nrf54h20dk/nrf54h20/cpuapp
  build_only: true
  sysbuild: true
tests:
  sample.suit.suit_ab_images:
    tags:
      - suit
      - bluetooth
      - ci_samples_suit

  sample.suit.suit_ab_images.ab_update:
    extra_args:
     # - DTC_OVERLAY_FILE="boards/nrf54h20dk_nrf54h20_cpuapp_ab_image.overlay"
      - SB_CONFIG_SUIT_BUILD_AB_UPDATE=y
      - SB_CONFIG_SUIT_MPI_APP_LOCAL_2=y
    tags:
      - suit
      - bluetooth
      - ci_samples_suit
      - ab_update      
```
